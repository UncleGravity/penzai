/dts-v1/;
/plugin/;

/*
 * loopback.dts — KR260 PL overlay for the DMA-loopback bitstream.
 *
 * Cloned from the board's known-good k26-starter-kits.dtbo (decompiled), with
 * only firmware-name changed. That overlay is deliberately minimal: it targets
 * the base tree's `fpga_full` label, names the bitstream, and asserts the 4 FPD
 * PL-PS reset lines. `/plugin/` + `&label` make dtc emit the __fixups__ that the
 * kernel resolves against the live __symbols__ at load time.
 *
 * Compile (dtc is on the board, or `nix shell nixpkgs#dtc` on the Mac):
 *   dtc -@ -O dtb -o penzai-loopback.dtbo loopback.dts
 *
 * NOTE: like the starter-kit, this has NO zocl node, so it brings up the PL but
 * not an XRT device. That is intentional for Stage A (load + MMIO-poke the DMA
 * via /dev/mem). Stage B adds a zocl node for the XRT BO memory path.
 */

/ {
	fragment@0 {
		target = <&fpga_full>;
		__overlay__ {
			#address-cells = <0x02>;
			#size-cells = <0x02>;
			firmware-name = "penzai-loopback.bit.bin";
			resets = <&zynqmp_reset 0x74
			          &zynqmp_reset 0x75
			          &zynqmp_reset 0x76
			          &zynqmp_reset 0x77>;
		};
	};
};
